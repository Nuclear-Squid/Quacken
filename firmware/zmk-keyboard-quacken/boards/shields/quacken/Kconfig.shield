## firmware/zmk-keyboard-quacken/boards/shields/quacken/Kconfig.shield
```kconfig
# No whitespace after the comma or in your keyboard name!
config SHIELD_QUACKEN
    def_bool $(shields_list_contains,quacken)
```

## firmware/zmk/boards/shields/quacken/Kconfig.defconfig
```kconfig
if SHIELD_MY_BOARD

# Name must be less than 16 characters long!
config SHIELD_QUACKEN
    default "Quacken"

endif
```
